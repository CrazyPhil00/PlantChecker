#include <Adafruit_SSD1306.h>
#include <splash.h>


#define SCREEN_WIDTH 128 // OLED display width, in pixels
#define SCREEN_HEIGHT 64 // OLED display height, in pixels
#define OLED_RESET     -1 // Reset pin # (or -1 if sharing Arduino reset pin)
#define SCREEN_ADDRESS 0x3C ///< See datasheet for Address; 0x3D for 128x64, 0x3C for 128x32
Adafruit_SSD1306 display(SCREEN_WIDTH, SCREEN_HEIGHT, &Wire, OLED_RESET);


#define MENU_BACKGROUND 0
#define MENU_SLIDER 1

#define MENU_TEMP -1
#define MENU_WATER_AMOUNT 0
#define MENU_WATER_DELAY 1
#define MENU_MIN_TEMP 2
#define MENU_MAX_TEMP 3
#define MENU_HEATER_DELAY 4
#define MENU_MAX_CO2 5
#define MENU_MIN_CO2 6


#define MENU_SLIDER_DISTANCE 12

int current_menu = 0;
int current_menu_type = MENU_BACKGROUND;
int menu_amount = 6;
int menu_value = 1;

#define menu_max_value 5
bool menu_active = false;

const int BUTTON_UP = 25;
const int BUTTON_DOWN = 26;
const int BUTTON_ENTER = 27;

int last_button_up;
int last_button_down;
int last_button_enter;



/**
 *
 * ------------------------------------------------------------------------------------------------------------
 *
 **/



const unsigned char epd_bitmap_menu_background [] PROGMEM = {
	0xff, 0xff, 0xff, 0xff, 0xff, 0xff, 0xff, 0xff, 0xff, 0xff, 0xff, 0xff, 0xff, 0xff, 0xff, 0xff, 
	0xe0, 0x00, 0x00, 0x00, 0x00, 0x00, 0x00, 0x00, 0x00, 0x00, 0x00, 0x00, 0x00, 0x00, 0x38, 0x01, 
	0xc0, 0x00, 0x00, 0x00, 0x00, 0x00, 0x00, 0x00, 0x00, 0x00, 0x00, 0x00, 0x00, 0x00, 0x18, 0x01, 
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	0xff, 0xff, 0xff, 0xff, 0xff, 0xff, 0xff, 0xff, 0xff, 0xff, 0xff, 0xff, 0xff, 0xff, 0xff, 0xff
};


const unsigned char epd_bitmap_menu_slider [] PROGMEM = {
	0xff, 0xff, 0xff, 0xff, 0xff, 0xff, 0xff, 0xff, 0xff, 0xff, 0xff, 0xff, 0xff, 0xff, 0xff, 0xff,
	0xe0, 0x00, 0x00, 0x00, 0x00, 0x00, 0x00, 0x00, 0x00, 0x00, 0x00, 0x00, 0x00, 0x00, 0x00, 0x07,
	0xc0, 0x00, 0x00, 0x00, 0x00, 0x00, 0x00, 0x00, 0x00, 0x00, 0x00, 0x00, 0x00, 0x00, 0x00, 0x03,
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	0xff, 0xff, 0xff, 0xff, 0xff, 0xff, 0xff, 0xff, 0xff, 0xff, 0xff, 0xff, 0xff, 0xff, 0xff, 0xff
};






/**
 *
 * ------------------------------------------------------------------------------------------------------------
 *
 **/







class MENU {
  public: void Initialize() {
    if (!display.begin(SSD1306_SWITCHCAPVCC, SCREEN_ADDRESS)) {
      Serial.println(F("SSD1306 allocation failed"));
      for (;;);
    }
    display.display();
    delay(100);
    display.clearDisplay();
  }

  void render() {

    display.clearDisplay();


      switch (current_menu_type)
      {
          case MENU_BACKGROUND:
          {

              if (digitalRead(BUTTON_UP) & !last_button_up) up();
              if (digitalRead(BUTTON_DOWN) & !last_button_down) down();
              if (digitalRead(BUTTON_ENTER) & !last_button_enter) menu_active = !menu_active;

              display.drawBitmap(0, 0, epd_bitmap_menu_background, 128, 64, WHITE);
              break;
          }

          case MENU_SLIDER:
          {

              if (digitalRead(BUTTON_UP) & !last_button_up) increase();
              if (digitalRead(BUTTON_DOWN) & !last_button_down) decrease();
              if (digitalRead(BUTTON_ENTER) & !last_button_enter) menu_active = !menu_active;

              display.drawBitmap(0, 0, epd_bitmap_menu_slider, 128, 64, WHITE);
              break;
          }
      }

    last_button_down = digitalRead(BUTTON_DOWN);
    last_button_up = digitalRead(BUTTON_UP);
    last_button_enter = digitalRead(BUTTON_ENTER);


    display.setTextSize(1);
    display.setTextColor(SSD1306_WHITE);

    switch (current_menu) {

    case MENU_TEMP: {

      break;
    }

    case MENU_WATER_AMOUNT: {

      if (menu_active) {

        current_menu_type = MENU_SLIDER;

        int x1 = 6;
        int x2 = 20;

        int value = 1;

        for (int i = 0; i < menu_max_value; ++i) {
          display.drawLine(x1, 22, x2, 22, SSD1306_WHITE);

          display.setCursor(x1 + (MENU_SLIDER_DISTANCE / 2), 22 - 8);

          display.print(value);

          x1 += MENU_SLIDER_DISTANCE * 2;
          x2 += MENU_SLIDER_DISTANCE * 2;
          value ++;
        }

        display.fillRect((MENU_SLIDER_DISTANCE / 2) * (menu_value * 4) - MENU_SLIDER_DISTANCE, 26, 3, 12, SSD1306_WHITE);

      } else {

          current_menu_type = MENU_BACKGROUND;

          display.setCursor(15, 6);
          display.print("Watering Amount");
          display.setCursor(15, 27);
          display.print("Water Delay");
          display.setCursor(15, 48);
          display.print("Minimal Temp");

        display.fillRect(121, 5, 3, 7, WHITE);
      }

      break;
    }

    case MENU_WATER_DELAY: {

      if (menu_active) {

          current_menu_type = MENU_SLIDER;



      } else {

          current_menu_type = MENU_BACKGROUND;

          display.setCursor(15, 6);
          display.print("Water Delay");
          display.setCursor(15, 27);
          display.print("Minimal Temp");
          display.setCursor(15, 48);
          display.print("Maximal Temp");

          display.fillRect(121, 13, 3, 7, WHITE);
      }

      break;
    }

    case MENU_MIN_TEMP: {

      if (menu_active) {

        current_menu_type = MENU_SLIDER;

      } else {

        current_menu_type = MENU_BACKGROUND;

        display.setCursor(15, 6);
        display.print("Minimal Temp");
        display.setCursor(15, 27);
        display.print("Maximal Temp");
        display.setCursor(15, 48);
        display.print("Minimal CO2");

        display.fillRect(121, 21, 3, 7, WHITE);
      }

      break;
    }

    case MENU_MAX_TEMP: {

      if (menu_active) {

        current_menu_type = MENU_SLIDER;

      } else {

        current_menu_type = MENU_BACKGROUND;

        display.setCursor(15, 6);
        display.print("Maximal Temp");
        display.setCursor(15, 27);
        display.print("Heater delay");
        display.setCursor(15, 48);
        display.print("Maximal CO2");

        display.fillRect(121, 29, 3, 7, WHITE);
      }
      break;
    }

    case MENU_HEATER_DELAY: {

      if (menu_active) {

        current_menu_type = MENU_SLIDER;

      } else {

        current_menu_type = MENU_BACKGROUND;

        display.setCursor(15, 6);
        display.print("Heater delay");
        display.setCursor(15, 27);
        display.print("Maximal CO2");
        display.setCursor(15, 48);
        display.print("Minimal CO2");

        display.fillRect(121, 37, 3, 7, WHITE);
      }
      break;
    }

    case MENU_MAX_CO2: {

      if (menu_active) {

        current_menu_type = MENU_SLIDER;

      } else {

        current_menu_type = MENU_BACKGROUND;

        display.setCursor(15, 6);
        display.print("Maximal CO2");
        display.setCursor(15, 27);
        display.print("Minimal CO2");

        display.fillRect(121, 45, 3, 7, WHITE);
      }
      break;
    }

    case MENU_MIN_CO2: {

      if (menu_active) {

        current_menu_type = MENU_SLIDER;

      } else {

        current_menu_type = MENU_BACKGROUND;

        display.setCursor(15, 6);
        display.print("Minimal CO2");

        display.fillRect(121, 53, 3, 7, WHITE);
      }
      break;
    }

    default: {
        if (menu_active)
        {
            ESP.restart();
        }
        else
        {

            current_menu_type = MENU_BACKGROUND;

          display.setCursor(15, 6);
          display.print("MENU ERROR");

          display.setCursor(15, 27);
          display.print("MENU.h:");
          display.print(__LINE__);

          display.setCursor(15, 48);
          display.print("Restart?");
          }
        }
    }

    display.display();
  }

  private:
  void up() {
    if (current_menu > 0) {
      current_menu--;
    }
  }

  void down() {
    if (current_menu < menu_amount + 1) {
      current_menu++;
    }
  }


  void increase() {
    if (menu_value < menu_max_value + 1) {
        menu_value ++;
    }
  }

  void decrease() {
    if (menu_value > 1) {
        menu_value --;
    }
  }

};
